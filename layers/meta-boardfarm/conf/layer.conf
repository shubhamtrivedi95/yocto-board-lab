## layers/meta-boardfarm/conf/layer.conf
```bitbake
# We have a conf and classes directory, add to BBPATH
BBPATH .= ":${LAYERDIR}"

# We have recipes-* directories, add to BBFILES
BBFILES += "${LAYERDIR}/recipes-*/*/*.bb \
            ${LAYERDIR}/recipes-*/*/*.bbappend"

BBFILE_COLLECTIONS += "meta-boardfarm"
BBFILE_PATTERN_meta-boardfarm = "^${LAYERDIR}/"
BBFILE_PRIORITY_meta-boardfarm = "6"

LAYERDEPENDS_meta-boardfarm = "core"
LAYERSERIES_COMPAT_meta-boardfarm = "wrynose"

BBFILES_DYNAMIC += "\
    meta-beagle:${LAYERDIR}/dynamic-layers/meta-ti/meta-beagle/recipes-kernel/linux/linux-bb.org_6.12.bbappend \
    meta-ti-extras:${LAYERDIR}/dynamic-layers/meta-ti/meta-ti-extras/recipes-bsp/cc33xx-fw/cc33xx-fw_git.bbappend \
    freescale-layer:${LAYERDIR}/dynamic-layers/meta-freescale/recipes-bsp/u-boot/u-boot-imx_2025.04.bbappend \
"
```

## layers/meta-boardfarm/conf/machine/rock-5t.conf
```bitbake
#@TYPE: Machine
#@NAME: Radxa Rock 5T
#@DESCRIPTION: ROCK5 is the 5th generation of SBC designed by Radxa.
#https://docs.radxa.com/en/rock5/rock5t

require conf/machine/include/rk3588.inc

# arch/arm64/boot/dts/rockchip/rk3588-rock-5t.dts
KERNEL_DEVICETREE = "rockchip/rk3588-rock-5t.dtb"
MACHINE_EXTRA_RRECOMMENDS += "kernel-modules"
# PREFERRED_PROVIDER_virtual/bootloader = "u-boot-rockchip"
PREFERRED_PROVIDER_virtual/bootloader = "u-boot"
UBOOT_MACHINE = "rock5t-rk3588_defconfig"
# UBOOT_MACHINE = "rk3588_defconfig"
```
